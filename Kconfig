## Kconfig
```kconfig
#
# For a description of the syntax of this configuration file,
# see doc/kconfig-language.txt.
#
mainmenu "SDK Configuration"


menu "SDK tool configuration"

    source "tools/toolchain/Kconfig.toolchain"

    config TOOLPREFIX
        string "Compiler toolchain path/prefix"
        default "arm-none-eabi-"
        ---help---
            The prefix/path that is used to call the toolchain. The default setting assumes
            a arm-gcc setup that is in your PATH.

endmenu


source "device/Kconfig.linkscript"


menu "System configuration"
    config SYSTEM_CLOCK
        int "System clock (Hz)"
        default "100000000"
        ---help---
            Set system clock

    choice OPTIMIZATION_LEVEL
        prompt "Optimization level"
        default OPTIMIZATION_LEVEL_DEBUG
        ---help---
            This option sets optimization level.

            - for "Release" setting, -Os flag is added to CFLAGS,
             and -DNDEBUG flag is added to CPPFLAGS.

            - for "Debug" setting, -Og flag is added to CFLAGS.

            To override any of these settings, set CFLAGS and/or CPPFLAGS

        config OPTIMIZATION_LEVEL_DEBUG
            bool "Debug (no optimization)"
            ---help---
                CFLAG with -O0 and -g

        config OPTIMIZATION_LEVEL_1
            bool "Debug (Level 1)"
            ---help---
                CFLAG with -O1 and -g

        config OPTIMIZATION_LEVEL_2
            bool "Debug (Level 2)"
            ---help---
                CFLAG with -O2 and -g

        config OPTIMIZATION_LEVEL_RELEASE
            bool "Release"
            ---help---
                CFLAG with -O3

    endchoice

    config ENABLE_QEMU_FUNCTIONS
        bool "Enable Qemu functions"
        default n
        ---help---
            Enable Qemu functions if device supports

endmenu

# source "$COMPONENT_KCONFIGS_PROJBUILD"

menu "Post build"
    config ENABLE_COPY_TARGET
        bool "Enable copy target after building"
        default n
        ---help---
            copy the output after building

    if ENABLE_COPY_TARGET

        config COPY_OUTPUT_FILE_TYPE_BIN
            bool "Copy output BIN file"
            default n
            ---help---
                Copy bin file after compiling

        config COPY_DEST_BIN_FILE_NAME
            string "The destination bin file name of copy"
            depends on COPY_OUTPUT_FILE_TYPE_BIN
            ---help---
                The destination name when cpoy bin file

        config COPY_OUTPUT_FILE_TYPE_ELF
            bool "Copy output ELF file"
            default n
            ---help---
              Copy elf file after compiling.

        config COPY_DEST_ELF_FILE_NAME
            string "The destination elf file name of copy"
            depends on COPY_OUTPUT_FILE_TYPE_ELF
            ---help---
                The destination name when cpoy elf file

        config COPY_DESTINATION
            string "The destination of copy"
            default "core_img"
            ---help---
                set the path of destination

    endif

    config ENABLE_SYNTAX_CHECKING
        bool "Enable syntax format checking"
        default y
        ---help---
            Check syntax format or not.

endmenu


menu "Module config"
    # source "$COMPONENT_KCONFIGS"
    source "middleware/Kconfig.components"
endmenu


menu "Device conifg"
    source "device/CMSIS/Kconfig"
    source "device/Kconfig.devices"
endmenu

menu "Core Images"
    source "core_img/Kconfig.imgs"
endmenu

menu "APP config"
    source "apps/Kconfig.app"
endmenu
```

## app/Kconfig
```kconfig
#
# For a description of the syntax of this configuration file,
# see Documentation/kbuild/kconfig-language.txt.
# Copyright (c) 2018 Wei-Lun Hsu
# @author  Wei-Lun Hsu
# @version 0.1
#

menu "Application Project"

comment "Application Project"

    choice
        prompt "Project"
        default project_1

    config project_1
        bool "project 1"
        ---help---
            project 1

    endchoice


endmenu
```

## apps/hello_world/Kconfig
```kconfig
#
# For a description of the syntax of this configuration file,
# see doc/kconfig-language.txt.
#

menu "hello_world"

	config VERSION
		int "version"
		default 0

endmenu
```

## apps/unittest/Kconfig
```kconfig
#
# For a description of the syntax of this configuration file,
# see doc/kconfig-language.txt.
#

source "apps/unittest/Kconfig.test"
```

## arch/Kconfig
```kconfig
#
# For a description of the syntax of this configuration file,
# see Documentation/kbuild/kconfig-language.txt.
# Copyright (c) 2018 Wei-Lun Hsu
# @author  Wei-Lun Hsu
# @version 0.1
#

menu "Chip Dependent"

comment "Chip Dependent"

    choice
        prompt "Chip Type"
        default Chip_A

    config Chip_A
        bool "Chip A"
        ---help---
            Chip A

    config Chip_B
        bool "Chip B"
        ---help---
            Chip B

    endchoice


endmenu
```

## board/Kconfig
```kconfig
#
# For a description of the syntax of this configuration file,
# see Documentation/kbuild/kconfig-language.txt.
# Copyright (c) 2018 Wei-Lun Hsu
# @author  Wei-Lun Hsu
# @version 0.1
#

menu "Board Support Package"

comment "Board support package"

    choice
        prompt "Board"
        default Board_Common

    config Board_Common
        bool "Board Common Package"
        ---help---
            Board Common Package

    config Board_1
        bool "Board Type 1"
        ---help---
            Board Type 1

    endchoice


endmenu
```

## device/CMSIS/Kconfig
```kconfig
#
# For a description of the syntax of this configuration file,
# see doc/kconfig-language.txt.
#

config ENABLE_CMSIS
    bool
    default y
```

## device/stm32f0/Kconfig
```kconfig
#
# For a description of the syntax of this configuration file,
# see doc/kconfig-language.txt.
#

menu "stm32f0"

    choice STM32F0_TARGET_BOARD
        prompt "target board"
        default STM32F0_EVB
        ---help---
            target board selection

        config STM32F0_EVB
            bool "stm32f0 EVB"

        config STM32F0_RDB
            bool "stm32f0 RDB"

    endchoice

    if STM32F0_EVB
        source "device/stm32f0/bsp/evb/Kconfig"
    endif

    if STM32F0_RDB
        source "device/stm32f0/bsp/rdb/Kconfig"
    endif
endmenu
```

## device/stm32f0/bsp/evb/Kconfig
```kconfig
#
# For a description of the syntax of this configuration file,
# see doc/kconfig-language.txt.
#


menu "evb"

    config KEY_GPIO
        int "GPIO of key"
        default 0
        ---help---
            set GPIO of key.

endmenu
```

## device/stm32f3/Kconfig
```kconfig
#
# For a description of the syntax of this configuration file,
# see doc/kconfig-language.txt.
#

menu "stm32f3"

    choice STM32F3_TARGET_BOARD
        prompt "target board"
        default STM32F3_EVB
        ---help---
            target board selection

        config STM32F3_EVB
            bool "stm32f3 EVB"

        config STM32F3_RDB
            bool "stm32f3 RDB"

    endchoice

    if STM32F3_EVB
        source device/stm32f3/bsp/evb/Kconfig
    endif

    if STM32F3_RDB
        source device/stm32f3/bsp/rdb/Kconfig
    endif
endmenu
```

## device/stm32f3/bsp/rdb/Kconfig
```kconfig
#
# For a description of the syntax of this configuration file,
# see doc/kconfig-language.txt.
#


menu "rdb"

    config KEY_GPIO
        int "GPIO of key"
        default 0
        ---help---
            set GPIO of key.

endmenu
```

## device/stm32f4/Kconfig
```kconfig
#
# For a description of the syntax of this configuration file,
# see doc/kconfig-language.txt.
#

menu "stm32f4"

    config STM32F4XX
        bool "Use stm32f4xx board"
        ---help---
            use stm32f4xx board

    config USE_STDPERIPH_DRIVER
        bool "Use stm32f4 std peripheral driver"
        ---help---
            use stm32f4 std peripheral driver


    choice STM32F4_TARGET_BOARD
        prompt "target board"
        default STM32F429I
        ---help---
            target board selection

        config STM32F429I
            bool "stm32f429i"

    endchoice


    if STM32F429I
        config QEMU_SIM_STM32F429I
            bool "Use Qemu to simulate stm32f429i"
            depends on ENABLE_QEMU_FUNCTIONS
            default n
            ---help---
                Qemu simulation

        source "device/stm32f4/bsp/stm32f429_439/Kconfig"
    endif

endmenu
```

## device/stm32f4/bsp/stm32f429_439/Kconfig
```kconfig
#
# For a description of the syntax of this configuration file,
# see doc/kconfig-language.txt.
#


menu "stm32f429i"

    config KEY_GPIO
        int "GPIO of key"
        default 0
        ---help---
            set GPIO of key.

endmenu
```

## device/stm32f429i/Kconfig
```kconfig
#
# For a description of the syntax of this configuration file,
# see doc/kconfig-language.txt.
#

menu "stm32f429i"

    config STM32F4XX
        bool "use stm32f4xx board"
        ---help---
            use stm32f4xx board

    config USE_STDPERIPH_DRIVER
        bool "use stm32f4 std peripheral driver"
        ---help---
            use stm32f4 std peripheral driver

endmenu
```

## device/t7610/Kconfig
```kconfig
#
# For a description of the syntax of this configuration file,
# see doc/kconfig-language.txt.
#

menu "t7610"

    config CPU_ARM_CM4
        def_bool y

    config CHIP_ALIAS_NIGHTHAWK
        def_bool y

    config CHIP_DEVICE_ID
        string "chip device ID"
        default "T7610"
        ---help---
            Chip ID

    config SYSTEM_STACK_SIZE
        int "The size of system STACK size (Bytes)"
        default "2048"
        ---help---
            The size of system stack size.

    config SYSTEM_HEAP_SIZE
        int "The size of system HEAP size (Bytes)"
        default "64"
        ---help---
            The size of system heap size.

    config AUTHENTICATION_MODULAR_NUMBER
        int
        default 22509125

    choice REMAP_TYPE
        prompt "target remap type"
        default REMAP_0
        ---help---
            target remap selection

        config REMAP_0
            bool "remap 0"
            ---help---
                Boot from Flash

        config REMAP_2
            bool "remap 2"
            ---help---
                Boot from SRAM (0x40000000 mapps to 0x00000000)

    endchoice

    config TARGET_REMAP_TYPE
        int
        default 0 if REMAP_0
        default 2 if REMAP_2
        ---help---
            target memory mapping type

    config ENABLE_ETH
        bool "Enable ethernet"
        default n
        ---help---
            enable ethernet or not

    config ENABLE_EXCEPTION_INFO
        bool "enable exception info"
        default n
        ---help---
            enable dump exception info when system hang

    choice T7610_TARGET_BOARD
        prompt "target board"
        default T7610_EVB
        ---help---
            target board selection

        config T7610_EVB
            bool "T7610 EVB"

        config T7610_FPGA
            bool "T7610 FPGA"

    endchoice

    if T7610_FPGA
        source "device/t7610/bsp/fpga/Kconfig"
    endif

    if T7610_EVB
        source "device/t7610/bsp/evb/Kconfig"
    endif

    if CPU_ARM_CM4

        # config ENABLE_DETECT_UNALIGNED
        #     default n
        #     bool "enable detect un-aligned memory access"
        #     ---help---
        #         ARM Contex M support 'Usage Fault'

        config ENABLE_DETECT_DIV0
            bool "enable detect divide by zero"
            default y
            ---help---
                ARM Contex M support 'Usage Fault'

    endif

    source "device/t7610/test/Kconfig"

endmenu
```

## device/t7610/bsp/evb/Kconfig
```kconfig
#
# For a description of the syntax of this configuration file,
# see doc/kconfig-language.txt.
#


menu "evb"

    choice DEBUG_PORT
        prompt "Target Debug Port"
        default DEBUG_PORT_UART
        ---help---
            Select the debug port.

        config DEBUG_PORT_UART
            bool "uart debug port"

    endchoice

    if DEBUG_PORT_UART

        config DEBUG_PORT_UART_ID
            int "UART debug port ID"
            default 0
            ---help---
                Set uart debug output port ID.

    endif

endmenu
```

## device/t7610/test/Kconfig
```kconfig
#
# For a description of the syntax of this configuration file,
# see doc/kconfig-language.txt.
#

menu "t7610 unit-test"

    config UNITTEST_WDT
        bool "unit-test WDT"
        default n
        ---help---
            unit-test WDT

    config UNITTEST_TIMER
        bool "unit-test Timer"
        default n
        ---help---
            unit-test Timer

    config UNITTEST_GPIO
        bool "unit-test GPIO"
        default n
        ---help---
            unit-test GPIO

    config UNITTEST_FC
        bool "unit-test FC"
        default n
        ---help---
            unit-test flash controlling

    config UNITTEST_SSP
        bool "unit-test SSP"
        default n
        ---help---
            unit-test SSP


endmenu
```

## drivers/Kconfig
```kconfig
#
# For a description of the syntax of this configuration file,
# see Documentation/kbuild/kconfig-language.txt.
# Copyright (c) 2018 Wei-Lun Hsu
# @author  Wei-Lun Hsu
# @version 0.1
#

menu "Drivers"

comment "Drivers"

    config ENABLE_GPIO
        bool "Enable GPIO"
        ---help---
            Enable GPIO

    config ENABLE_TIMER
        bool "Enable Timer"
        ---help---
            Enable Timer


endmenu
```

## kernel/Kconfig
```kconfig
#
# For a description of the syntax of this configuration file,
# see Documentation/kbuild/kconfig-language.txt.
# Copyright (c) 2018 Wei-Lun Hsu
# @author  Wei-Lun Hsu
# @version 0.1
#

menu "Kernel (Operating System)"

comment "Kernel (Operating System)"

    choice
        prompt "Kernel Type"
        default Kernel_F9

    config Kernel_F9
        bool "Kernel F9"
        ---help---
            Kernel: F9 Microkernel

    config Kernel_FreeRTOS
        bool "Kernel FreeRTOS"
        ---help---
            Kernel: FreeRTOS

    endchoice


endmenu
```

## middleware/private/common/Kconfig
```kconfig
#
# For a description of the syntax of this configuration file,
# see doc/kconfig-language.txt.
#

menu "private-common"

    config ENABLE_COMMON
        bool "enable common module"
        default y
        ---help---
            enable common or not

endmenu
```

## middleware/private/utils/Kconfig
```kconfig
#
# For a description of the syntax of this configuration file,
# see doc/kconfig-language.txt.
#

menu "private-utils"

    config ENABLE_UTILS
        bool "enable utils module"
        default n
        ---help---
            enable utils or not


    if ENABLE_UTILS

        config ENABLE_LOG
            bool "Enable system log"
            default n
            ---help---
                enable system log or not

        if ENABLE_LOG
            config ENABLE_LOG_TEE
                bool "Enable log record"
                default n
                ---help---
                    enable log record or not
        endif

        config ENABLE_SHELL_CMD_HISTORY
            bool "Enable history of shell console"
            default n
            ---help---
                enable history of shell console or not


    endif

endmenu
```

## middleware/third_party/cm_backtrace/Kconfig
```kconfig
#
# For a description of the syntax of this configuration file,
# see doc/kconfig-language.txt.
#

menu "cm_backtrace"

    config ENABLE_CM_BACKTRACE
        bool "enable cm_backtrace module"
        default n
        ---help---
            enable cm_backtrace or not.

    if ENABLE_CM_BACKTRACE

        config ENABLE_DUMP_STACK_INFO
            bool "enable dump stack information"
            default n
            ---help---
                Enable dump stack information or not.

        config USE_FREERTOS_PLATFORM
            bool "Use freeRTOS platform"
            default y if ENABLE_FREERTOS
            default n
            ---help---
                Use freeRTOS platform or not.

    endif

endmenu
```
