## middleware/third_party/freertos/Kconfig
```kconfig
#
# For a description of the syntax of this configuration file,
# see doc/kconfig-language.txt.
#

menu "freertos"

    config ENABLE_FREERTOS
        bool "enable freertos module"
        default n
        ---help---
            enable freertos or not.

    if ENABLE_FREERTOS

        config FREERTOS_HEAP_SIZE
            int "The size of individual heap size (Bytes)"
            default "0"
            ---help---
                The size of individual heap size. 0 indicates to use global heap management.

    endif

endmenu
```

## middleware/third_party/json/Kconfig
```kconfig
#
# For a description of the syntax of this configuration file,
# see doc/kconfig-language.txt.
#


menu "json"

    config ENABLE_JSON
        bool "enable json module"
        default n
        ---help---
            enable json or not.

endmenu
```

## middleware/third_party/pt/Kconfig
```kconfig
#
# For a description of the syntax of this configuration file,
# see doc/kconfig-language.txt.
#


menu "pt"

    config ENABLE_PT
        bool "enable protothread module"
        default n
        ---help---
            enable protothreads or not.

endmenu
```

## mw/Kconfig
```kconfig
#
# For a description of the syntax of this configuration file,
# see Documentation/kbuild/kconfig-language.txt.
# Copyright (c) 2018 Wei-Lun Hsu
# @author  Wei-Lun Hsu
# @version 0.1
#

menu "Middleware"

comment "Middleware"

    config ENABLE_IPC
        bool "Enable IPC"
        ---help---
            Enable IPC

        if ENABLE_IPC
            menu "IPC Setting"
                config MAX_QUEUE_NUM
                    int "Max Queue Number"
                    default "3"
                    ---help---
                        Max Queue Number

            endmenu
        endif

    source mw/third_party/Kconfig

endmenu
```

## mw/third_party/Kconfig
```kconfig
#
# For a description of the syntax of this configuration file,
# see Documentation/kbuild/kconfig-language.txt.
# Copyright (c) 2018 Wei-Lun Hsu
# @author  Wei-Lun Hsu
# @version 0.1
#

menu "Middleware with 3-th Party"

comment "Middleware with 3-th Party"

    config ENABLE_LWIP
        bool "Enable lwip"
        ---help---
            Enable lwip


endmenu
```
